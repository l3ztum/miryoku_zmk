// Copyright 2022 Manna Harbour
// https://github.com/manna-harbour/miryoku

#include "../miryoku/custom_config.h"

#define HAS_MOUSE_KEYS
#define HAS_MOUSE_TP

#define MOUSE_KEYS 2
#define MOUSE_TP 5
#define MOUSE_TP_SET 5

#ifdef HAS_MOUSE_KEYS
  #include <dt-bindings/zmk/mouse.h>
  #include <behaviors/mouse_keys.dtsi>
#endif  // HAS_MOUSE_KEYS

#ifdef HAS_MOUSE_TP
  // We store the trackpoint settings in a separate file
  // to make organization a little easier.
  #include "include/mouse_tp.dtsi"
#endif  // HAS_MOUSE_TP

#include "../miryoku/mapping/38/totem.h"
#include "../miryoku/miryoku.dtsi"
